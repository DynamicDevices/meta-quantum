## conf/layer.conf
```bitbake
# We might have a conf and classes directory, append to BBPATH
BBPATH .= ":${LAYERDIR}"

# We have a recipes directory, add to BBFILES
BBFILES += "${LAYERDIR}/recipes*/*/*.bb ${LAYERDIR}/recipes*/*/*.bbappend"

BBFILE_COLLECTIONS += "meta-quantum-safe"
BBFILE_PATTERN_meta-quantum-safe := "^${LAYERDIR}/"
BBFILE_PRIORITY_meta-quantum-safe = "5"

LAYERDEPENDS_meta-quantum-safe = ""
LAYERSERIES_COMPAT_meta-quantum-safe = "kirkstone"

PREFERRED_VERSION_liboqs ?= "git"
```
